## config/west.yml
```yaml
manifest:
  remotes:
    - name: zmkfirmware
      url-base: https://github.com/allymparker
  projects:
    - name: zmk
      remote: zmkfirmware
      revision: sensor-channel
      import: app/west.yml
  self:
    path: config
```
